## arch/armv7m/stm32l4/Kconfig
```kconfig
if ARCH_CHIP_FAMILY_STM32L4

#the following configs define the availability of peripherals on each of the derivative
#this allows the display of only available peripherals on a derivative

config HAVE_GPIOA
	bool
	default n

config HAVE_GPIOB
	bool
	default n

config HAVE_GPIOC
	bool
	default n

config HAVE_GPIOD
	bool
	default n

config HAVE_GPIOE
	bool
	default n

config HAVE_GPIOF
	bool
	default n

config HAVE_GPIOG
	bool
	default n

config HAVE_GPIOH
	bool
	default n

config HAVE_USART1
	bool
	default n

config HAVE_USART2
	bool
	default n

config HAVE_LPUART1
	bool
	default n


config HAVE_TIM1
	bool
	default n

config HAVE_TIM2
	bool
	default n

config HAVE_TIM6
	bool
	default n

config HAVE_TIM7
	bool
	default n

config HAVE_TIM15
	bool
	default n

config HAVE_TIM16
	bool
	default n

config HAVE_LPTIM1
	bool
	default n

config HAVE_LPTIM2
	bool
	default n


config HAVE_DMA1
	bool
	default n

config HAVE_DMA2
	bool
	default n


config HAVE_SPI1
	bool
	default n

config HAVE_SPI3
	bool
	default n


config HAVE_I2C1
	bool
	default n

config HAVE_I2C3
	bool
	default n


config HAVE_CAN1
	bool
	default n


config HAVE_RNG
	bool
	default n

config HAVE_ADC
	bool
	default n

config HAVE_TSC
	bool
	default n

config HAVE_CRC
	bool
	default n

config HAVE_SAI1
	bool
	default n

config HAVE_SWPMI1
	bool
	default n

config HAVE_COMP
	bool
	default n

config HAVE_OPAMP
	bool
	default n

config HAVE_DAC
	bool
	default n

config HAVE_USBFS
	bool
	default n

config HAVE_OTGFS
	bool
	default n

config HAVE_CRS
	bool
	default n

config HAVE_IWDG
	bool
	default n

config HAVE_WWDG
	bool
	default n

config HAVE_RTC
	bool
	default n


config HAVE_AES
	bool
	default n

#a model family groups peripherals available to more than one chip

config ARCH_CHIPFAMILY_STM32L4X6
	bool
	select HAVE_RNG
	select HAVE_ADC
	select HAVE_OTGFS
	select HAVE_GPIOH
	select HAVE_GPIOG
	select HAVE_GPIOF
	select HAVE_GPIOE
	select HAVE_GPIOD
	select HAVE_GPIOC
	select HAVE_GPIOB
	select HAVE_GPIOA
	select HAVE_TSC
	select HAVE_CRC
	select HAVE_DMA2
	select HAVE_DMA1
	select HAVE_DFSDM
	select HAVE_SAI2
	select HAVE_SAI1
	select HAVE_TIM17
	select HAVE_TIM16
	select HAVE_TIM15
	select HAVE_USART1
	select HAVE_TIM8
	select HAVE_SPI1
	select HAVE_TIM1
	select HAVE_SDMMC1
	select HAVE_COMP
	select HAVE_VREFBUF
	select HAVE_LPTIM2
	select HAVE_SWPMI1
	select HAVE_LPUART1
	select HAVE_LPTIM1
	select HAVE_OPAMP
	select HAVE_DAC
	select HAVE_CAN1
	select HAVE_I2C3
	select HAVE_I2C2
	select HAVE_I2C1
	select HAVE_UART5
	select HAVE_UART4
	select HAVE_USART3
	select HAVE_USART2
	select HAVE_SPI3
	select HAVE_SPI2
	select HAVE_IWDG
	select HAVE_WWDG
	select HAVE_RTC
	select HAVE_LCD
	select HAVE_TIM7
	select HAVE_TIM6
	select HAVE_TIM5
	select HAVE_TIM4
	select HAVE_TIM3
	select HAVE_TIM2

config ARCH_CHIPFAMILY_STM32L4X3
  bool
	#always present FLASH PWR RCC FIREWALL SYSCFG EXTI
	select HAVE_RNG
	select HAVE_ADC
	select HAVE_GPIOH
	select HAVE_GPIOC
	select HAVE_GPIOB
	select HAVE_GPIOA
	select HAVE_TSC
	select HAVE_CRC
	select HAVE_DMA2
	select HAVE_DMA1
	select HAVE_SAI1
	select HAVE_TIM16
	select HAVE_TIM15
	select HAVE_USART1
	select HAVE_SPI1
	select HAVE_TIM1
	select HAVE_COMP
	select HAVE_LPTIM2
	select HAVE_SWPMI1
	select HAVE_LPUART1
	select HAVE_LPTIM1
	select HAVE_OPAMP
	select HAVE_DAC
	select HAVE_USBFS
	select HAVE_CAN1
	select HAVE_CRS
	select HAVE_I2C3
	select HAVE_I2C1
	select HAVE_USART2
	select HAVE_SPI3
	select HAVE_IWDG
	select HAVE_WWDG
	select HAVE_RTC
	select HAVE_TIM7
	select HAVE_TIM6
	select HAVE_TIM2

#this allows to choose a particular model
choice
	prompt "L4 model"

config ARCH_CHIP_STM32L432KC
	bool "STM32L432KC (UFQFPN32, 5x5)"
  select ARCH_CHIPFAMILY_STM32L4X3

config ARCH_CHIP_STM32L476RG
	bool "STM32L476RG (TQFP64)"
	select ARCH_CHIPFAMILY_STM32L4X6

config ARCH_CHIP_STM32L486RG
	bool "STM32L486RG (TQFP64)"
	select ARCH_CHIPFAMILY_STM32L4X6
	select HAVE_AES

endchoice

menu "Peripheral enable"

comment "--- APB1 ---"

config STM32L4_TIM2
	bool "TIM2 (unsupported)"
	default n
	depends on HAVE_TIM2

config STM32L4_TIM3
	bool "TIM3 (unsupported)"
	default n
	depends on HAVE_TIM3

config STM32L4_TIM4
	bool "TIM4 (unsupported)"
	default n
	depends on HAVE_TIM4
	
config STM32L4_TIM5
	bool "TIM5 (unsupported)"
	default n
	depends on HAVE_TIM5
	
config STM32L4_TIM6
	bool "TIM6 (unsupported)"
	default n
	depends on HAVE_TIM6
	
config STM32L4_TIM7
	bool "TIM7 (unsupported)"
	default n
	depends on HAVE_TIM7

config STM32L4_LCD
	bool "LCD (unsupported)"
	default n
	depends on HAVE_LCD

config STM32L4_RTC
	bool "RTC (unsupported)"
	default n
	depends on HAVE_RTC

config STM32L4_WWDG
	bool "WWDG (unsupported)"
	default n
	depends on HAVE_WWDG

config STM32L4_IWDG
	bool "IWDG (unsupported)"
	default n
	depends on HAVE_IWDG

config STM32L4_SPI2
	bool "SPI2 (unsupported)"
	default n
	depends on HAVE_SPI2

config STM32L4_SPI3
	bool "SPI3 (unsupported)"
	default n
	depends on HAVE_SPI3

config STM32L4_USART2
	bool "USART2"
	default n
	depends on HAVE_USART2

config STM32L4_USART3
	bool "USART3"
	default n
	depends on HAVE_USART3

config STM32L4_UART4
	bool "UART4"
	default n
	depends on HAVE_UART4

config STM32L4_UART5
	bool "UART5"
	default n
	depends on HAVE_UART5

config STM32L4_I2C1
	bool "I2C1 (unsupported)"
	default n
	depends on HAVE_I2C1

config STM32L4_I2C2
	bool "I2C2 (unsupported)"
	default n
	depends on HAVE_I2C2

config STM32L4_I2C3
	bool "I2C3 (unsupported)"
	default n
	depends on HAVE_I2C3

config STM32L4_CAN1
	bool "CAN1 (unsupported)"
	default n
	depends on HAVE_CAN1

config STM32L4_PWR
	bool "PWR"
	default y

config STM32L4_DAC1
	bool "DAC1 (unsupported)"
	default n
	depends on HAVE_DAC1

config STM32L4_OPAMP
	bool "OPAMP (unsupported)"
	default n
	depends on HAVE_OPAMP

config STM32L4_LPTIM1
	bool "LPTIM1 (unsupported)"
	default n
	depends on HAVE_LPTIM1

config STM32L4_LPUART1
	bool "LPUART1 (unsupported)"
	default n
	depends on HAVE_LPUART1

config STM32L4_SWPMI1
	bool "SWPMI1 (unsupported)"
	default n
	depends on HAVE_SWPMI

config STM32L4_LPTIM2
	bool "LPTIM2 (unsupported)"
	default n
	depends on HAVE_LPTIM2

comment "--- APB2 ---"

config STM32L4_SYSCFG
	bool "SYSCFG (unsupported)"
	default y

config STM32L4_VREFBUF
	bool "VREFBUF (unsupported)"
	default n
	depends on HAVE_VREFBUF

config STM32L4_COMP
	bool "COMP (unsupported)"
	default n
	depends on HAVE_COMP

config STM32L4_EXTI
	bool "EXTI (unsupported)"
	default n
	
config STM32L4_FIREWALL
	bool "FIREWALL (unsupported)"
	default n

config STM32L4_SDMMC1
	bool "SDMMC1 (unsupported)"
	default n
	depends on HAVE_SDMMC1

config STM32L4_TIM1
	bool "TIM1 (unsupported)"
	default n
	depends on HAVE_TIM1

config STM32L4_SPI1
	bool "SPI1 (unsupported)"
	default n
	depends on HAVE_SPI1

config STM32L4_TIM8
	bool "TIM8 (unsupported)"
	default n
	depends on HAVE_TIM8

config STM32L4_USART1
	bool "USART1"
	default n
	depends on HAVE_USART1

config STM32L4_TIM15
	bool "TIM15 (unsupported)"
	default n
	depends on HAVE_TIM15

config STM32L4_TIM16
	bool "TIM16 (unsupported)"
	default n
	depends on HAVE_TIM16

config STM32L4_TIM17
	bool "TIM17 (unsupported)"
	default n
	depends on HAVE_TIM17

config STM32L4_SAI1
	bool "SAI1 (unsupported)"
	default n
	depends on HAVE_SAI1

config STM32L4_SAI2
	bool "SAI2 (unsupported)"
	default n
	depends on HAVE_SAI2

config STM32L4_DFSDM1
	bool "DFSDM1 (unsupported)"
	default n
	depends on HAVE_DFSDM1

comment "--- AHB1 ---"

config STM32L4_DMA1
	bool "DMA1 (unsupported)"
	default n
	depends on HAVE_DMA1

config STM32L4_DMA2
	bool "DMA2 (unsupported)"
	default n
	depends on HAVE_DMA2

config STM32L4_RCC
	bool "RCC"
	default y

config STM32L4_FLASH
	bool "FLASH (unsupported)"
	default n

config STM32L4_CRC
	bool "CRC (unsupported)"
	default n
	depends on HAVE_CRC

config STM32L4_TSC
	bool "TSC (unsupported)"
	default n
	depends on HAVE_TSC


comment "--- AHB2 ---"

config STM32L4_GPIOA
	bool "GPIOA"
	default n
	depends on HAVE_GPIOA

config STM32L4_GPIOB
	bool "GPIOB"
	default n
	depends on HAVE_GPIOB

config STM32L4_GPIOC
	bool "GPIOC"
	default n
	depends on HAVE_GPIOC

config STM32L4_GPIOD
	bool "GPIOD"
	default n
	depends on HAVE_GPIOD

config STM32L4_GPIOE
	bool "GPIOE"
	default n
	depends on HAVE_GPIOE

config STM32L4_GPIOF
	bool "GPIOF"
	default n
	depends on HAVE_GPIOF

config STM32L4_GPIOG
	bool "GPIOG"
	default n
	depends on HAVE_GPIOG

config STM32L4_GPIOH
	bool "GPIOH"
	default n
	depends on HAVE_GPIOH

config STM32L4_USBFS
	bool "OTGFS (unsupported)"
	default n
	depends on HAVE_USBFS

config STM32L4_OTGFS
	bool "OTGFS (unsupported)"
	default n
	depends on HAVE_OTGFS

config STM32L4_ADC
	bool "ADC (unsupported)"
	default n
	depends on HAVE_ADC

config STM32L4_AES
	bool "AES (unsupported)"
	default n
	depends on HAVE_AES

config STM32L4_RNG
	bool "RNG (unsupported)"
	default n
	depends on HAVE_RNG

endmenu

menu "UART config"

choice
  prompt "UART to use as kernel console"

config STM32L4_USART1_KCONSOLE
  bool "USART1"
  depends on STM32L4_USART1 || STM32L4_USART2 || STM32L4_USART3 || STM32_UART4 || STM32L4_UART5

endchoice

if STM32L4_USART1

comment "--- USART1 ---"

choice
  prompt "USART TX pin"

config STM32L4_USART1_TX_0
  bool "None"

config STM32L4_USART1_TX_1
  bool "PA9"

config STM32L4_USART1_TX_2
  bool "PB6"

endchoice

choice
  prompt "USART TX pin"

config STM32L4_USART1_RX_0
  bool "None"

config STM32L4_USART1_RX_1
  bool "PA10"

config STM32L4_USART1_RX_2
  bool "PB7"

endchoice

config STM32L4_USART1_BAUDRATE
  int "USART1 default baud rate"
  default 115200

choice
  prompt "USART1 default parity"

config STM32L4_USART1_PARITY_NONE
  bool "None"

config STM32L4_USART1_PARITY_ODD
  bool "Odd"

config STM32L4_USART1_PARITY_EVEN
  bool "Even"

endchoice

config STM32L4_USART1_STOPBITS
  int "USART1 default stop bits"
  default 1

endif

endmenu #uart config

config STM32L4_CLOCKHOOK_MAX
  int "Maximum number of clock change hooks"

endif
```

## arch/armv8m/Kconfig
```kconfig
if ARCH_ARMV8M

#specific config to tell apart ARMV8-M (cortex M23) chips

choice
	prompt "CPU family"

config ARCH_CHIP_FAMILY_SAML11
	bool "SAML11 (Cortex M23)"

endchoice

#this is the name of the subdir
config ARCH_CHIP_FAMILY
	string
	default "saml11" if ARCH_CHIP_FAMILY_SAML11

source arch/armv8m/saml11/Kconfig

config ARMV8M_SYSTICK
	bool "Enable SYSTICK"

endif
```

## arch/armv8m/saml11/Kconfig
```kconfig
if ARCH_CHIP_FAMILY_SAML11

choice
	prompt "SAML11 model"

config ARCH_CHIP_SAML11E16
	bool "SAML11E16"

endchoice

endif #ARCH_CHIP_FAMILY_SAML11
```

## board/nucleo-f411re/Kconfig
```kconfig
config BOARD_NUCLEO_F411RE
	bool "nucleo-f411re"
	depends on ARCH_CHIP_STM32F411RE

if BOARD_NUCLEO_F411RE

config BOARD_NUCLEO_F411RE_DUMMY 
	bool "Dummy F411 setting for tests"

endif
```

## board/nucleo-l432kc/Kconfig
```kconfig
config BOARD_NUCLEO_L432KC
	bool "nucleo-l432kc"
	depends on ARCH_CHIP_STM32L432KC

if BOARD_NUCLEO_L432KC

config BOARD_NUCLEO_L432KC_DUMMY
	bool "Dummy L432KC setting for tests"

endif
```

## board/nucleo-l476rg/Kconfig
```kconfig
config BOARD_NUCLEO_L476RG
	bool "nucleo-l476rg"
	depends on ARCH_CHIP_STM32L476RG

if BOARD_NUCLEO_L476RG

config BOARD_NUCLEO_L476RG_DUMMY
	bool "Dummy L476 setting for tests"

endif
```

## board/saml11xplained/Kconfig
```kconfig
config BOARD_SAML11XPLAINED
	bool "saml11-xplained"
	depends on ARCH_CHIP_SAML11E16

if BOARD_SAML11XPLAINED

config BOARD_SAML11XPLAINED_DUMMY
	bool "Dummy SAML11-XPLAINED setting for tests"

endif
```

## board/stm32f103-minimum/Kconfig
```kconfig
config BOARD_STM32F103MINIMUM
	bool "stm32f103minimum"
	depends on ARCH_CHIP_STM32F103C8

if BOARD_STM32F103MINIMUM

config BOARD_STM32F103MINIMUM_DUMMY
	bool "Dummy STM32F103 Minimum setting for tests"

endif
```
