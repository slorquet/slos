## Kconfig
```kconfig
mainmenu "slos configuration"

config CLANG
	bool "Use CLANG/LLVM instead of arm-none-eabi-gcc"

config DEBUG
	bool "Enable debug messages"

menu "Arch options"
source arch/Kconfig
endmenu

menu "Board options"
source board/Kconfig

config BOARD_LDSCRIPT
	string "ld script for final linking"

endmenu
```

## arch/Kconfig
```kconfig
choice
	prompt "CPU architecture"

config ARCH_ARMV7M
	bool "armv7m (Cortex-M3, Cortex-M4)"

config ARCH_ARMV8M
	bool "armv8m (Cortex-M23)"

endchoice

config ARCH
	string
	default "armv7m" if ARCH_ARMV7M
	default "armv8m" if ARCH_ARMV8M

source arch/armv7m/Kconfig
source arch/armv8m/Kconfig
```

## arch/armv7m/Kconfig
```kconfig
if ARCH_ARMV7M

#specific config to tell apart ARMV7E-M (cortex M4) chips
#from ARMv7-M (Cortex M3) chips

config ARCH_ARMV7EM
	bool
	default n

choice
	prompt "CPU family"

config ARCH_CHIP_FAMILY_STM32F1
	bool "STM32F1 (Cortex M3)"

config ARCH_CHIP_FAMILY_STM32F4
	bool "STM32F4 (Cortex M4)"
	select ARCH_ARMV7EM

config ARCH_CHIP_FAMILY_STM32L4
	bool "STM32L4 (Cortex M4)"
	select ARCH_ARMV7EM

endchoice

#this is the name of the subdir
config ARCH_CHIP_FAMILY
	string
	default "stm32f1" if ARCH_CHIP_FAMILY_STM32F1
	default "stm32f4" if ARCH_CHIP_FAMILY_STM32F4
	default "stm32l4" if ARCH_CHIP_FAMILY_STM32L4

source arch/armv7m/stm32f1/Kconfig
source arch/armv7m/stm32f4/Kconfig
source arch/armv7m/stm32l4/Kconfig

endif
```

## arch/armv7m/stm32f1/Kconfig
```kconfig
if ARCH_CHIP_FAMILY_STM32F1

#stm32f1 has multiple 'lines' which define features such as interrupts

#connectivity groups all f105 and f107 devinces
config STM32F1_LINE_CONNECTIVITY
  bool
  
#f101,f102,f103 with 16-32k flash
config STM32F1_LINE_LOWDENSITY
  bool

#f101,f102,f103 with 64-128k flash
config STM32F1_LINE_MEDDENSITY
  bool

#f101,f103 with 256-512 flash
config STM32F1_LINE_HIGHDENSITY
  bool

#f101,f103 with 768-1024k flash
config STM32F1_LINE_XLDENSITY
  bool

#f103xx is performance line
config STM32F1_LINE_PERFORMANCE
  bool

#f102xx is access line
config STM32F1_LINE_USBACCESS
  bool

choice
	prompt "F1 model"

config ARCH_CHIP_STM32F103C8
	bool "STM32F103C8 (TQFP48, 64k flash)"
  select STM32F1_LINE_MEDDENSITY
  select STM32F1_LINE_PERFORMANCE

endchoice

if STM32F1_LINE_LOWDENSITY
comment "-- Info: Peripheral family: Low-density"
endif

if STM32F1_LINE_MEDDENSITY
comment "-- Info: Peripheral family: Med-density"
endif

if STM32F1_LINE_HIGHDENSITY
comment "-- Info: Peripheral family: High-density"
endif

if STM32F1_LINE_XLDENSITY
comment "-- Info: Peripheral family: Extra-High-density"
endif

if STM32F1_LINE_CONNECTIVITY
comment "-- Info: Peripheral family: Connectivity line"
endif

menu "Peripherals enable"

comment "--- APB1 ---"

config STM32F1_TIM2
  bool "TIM2"
  default n
  
config STM32F1_TIM3
  bool "TIM3"
  default n

config STM32F1_TIM4
  bool "TIM4"
  default n

config STM32F1_TIM5
  bool "TIM5"
  default n

config STM32F1_TIM6
  bool "TIM6"
  default n

config STM32F1_TIM7
  bool "TIM7"
  default n

config STM32F1_TIM12
  bool "TIM12"
  default n

config STM32F1_TIM13
  bool "TIM13"
  default n

config STM32F1_TIM14
  bool "TIM14"
  default n

config STM32F1_RTC
  bool "RTC"
  default n

config STM32F1_WWDG
  bool "WWDG"
  default n

config STM32F1_IWDG
  bool "IWDG"
  default n

config STM32F1_SPI2
  bool "SPI2"
  default n

config STM32F1_SPI3
  bool "SPI3"
  default n

config STM32F1_USART2
  bool "USART2"
  default n

config STM32F1_USART3
  bool "USART3"
  default n

config STM32F1_UART4
  bool "UART4"
  default n

config STM32F1_UART5
  bool "UART5"
  default n

config STM32F1_I2C1
  bool "I2C1"
  default n

config STM32F1_I2C2
  bool "I2C2"
  default n

config STM32F1_USBFS
  bool "USBFS"
  default n
  depends on STM32F1_LINE_PERFORMANCE || STM32F1_LINE_USBACCESS
  
config STM32F1_CAN1
  bool "CAN1"
  default n

config STM32F1_CAN2
  bool "CAN2"
  default n
  depends on STM32F1_LINE_CONNECTIVITY || STM32F1_LINE_PERFORMANCE

config STM32F1_BKP
  bool "BKP"
  default n

config STM32F1_PWR
  bool "PWR"
  default n

config STM32F1_DAC
  bool "DAC"
  default n

comment "--- APB2 ---"

config STM32F1_AFIO
  bool "AFIO"
  default n

config STM32F1_EXTI
  bool "EXTI"
  default n

config STM32F1_GPIOA
  bool "GPIOA"
  default n

config STM32F1_GPIOB
  bool "GPIOB"
  default n

config STM32F1_GPIOC
  bool "GPIOC"
  default n

config STM32F1_GPIOD
  bool "GPIOD"
  default n

config STM32F1_GPIOE
  bool "GPIOE"
  default n

config STM32F1_GPIOF
  bool "GPIOF"
  default n
  depends on !STM32F1_LINE_CONNECTIVITY

config STM32F1_GPIOG
  bool "GPIOG"
  default n
  depends on !STM32F1_LINE_CONNECTIVITY

config STM32F1_ADC1
  bool "ADC1"
  default n

config STM32F1_ADC2
  bool "ADC2"
  default n

config STM32F1_TIM1
  bool "TIM1"
  default n

config STM32F1_SPI1
  bool "SPI1"
  default n

config STM32F1_TIM8
  bool "TIM8"
  default n

config STM32F1_USART1
  bool "USART1"
  default n

config STM32F1_ADC3
  bool "ADC3"
  default n

config STM32F1_TIM9
  bool "TIM9"
  default n

config STM32F1_TIM10
  bool "TIM10"
  default n

config STM32F1_TIM11
  bool "TIM11"
  default n

comment "--- AHB ---"

config STM32F1_SDIO
  bool "SDIO"
  default n
  depends on STM32F1_LINE_HIGHDENSITY || STM32F1_LINE_XLDENSITY

config STM32F1_DMA1
  bool "DMA1"
  default n

config STM32F1_DMA2
  bool "DMA2"
  default n

config STM32F1_RCC
  bool "RCC"
  default n

config STM32F1_FLASH
  bool "FLASH"
  default n

config STM32F1_CRC
  bool "CRC"
  default n

config STM32F1_ETH
  bool "ETH"
  default n

config STM32F1_OTGFS
  bool "OTGFS"
  default n
  depends on STM32F1_LINE_CONNECTIVITY

config STM32F1_FSMC
  bool "FSMC"
  default n

endmenu

menu "UART config"

choice
  prompt "UART to use as kernel console"

config STM32F1_USART1_KCONSOLE
  bool "USART1"
  depends on STM32F1_USART1

endchoice

if STM32F1_USART1

comment "--- USART1 ---"

choice
  prompt "USART IO remap config"

config STM32F1_USART1_REMAP_NONE
  bool "Normal : TX=PA9 TX=PA10"

config STM32F1_USART1_REMAP
  bool "Remapped : TX=PB6 RX=PB7"

endchoice

config STM32F1_USART1_BAUDRATE
  int "USART1 default baud rate"
  default 115200

choice
  prompt "USART1 default parity"

config STM32F1_USART1_PARITY_NONE
  bool "None"

config STM32F1_USART1_PARITY_ODD
  bool "Odd"

config STM32F1_USART1_PARITY_EVEN
  bool "Even"

endchoice

config STM32F1_USART1_DATABITS
  int "USART1 default data bits"
  default 8

config STM32F1_USART1_STOPBITS
  int "USART1 default stop bits"
  default 1

endif

endmenu

endif
```

## arch/armv7m/stm32f4/Kconfig
```kconfig
if ARCH_CHIP_FAMILY_STM32F4

choice
	prompt "F4 model"

config ARCH_CHIP_STM32F411
	bool "STM32F411"

endchoice

menu "Peripheral enable"

comment "--- APB1 TODO ---"

comment "--- APB2 TODO ---"

comment "--- AHB1 TODO ---"

comment "--- AHB2 TODO ---"

endmenu

endif
```
